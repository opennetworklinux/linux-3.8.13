## Documentation/devicetree/bindings/powerpc/fsl/fsl-dce.txt
```
=====================================================================
DCE Device Tree Binding
Copyright (C) 2012 Freescale Semiconductor Inc.

 CONTENTS
   -Overview
   -DCE Node and Example

NOTE: the DCE is also known as Freescale's Decompression and Compression Engine

=====================================================================
Overview

DESCRIPTION

    The Decompression and Compression Engine is an accelerator compatible
    with Datapath Architecture providing lossless data decompression and
    compression for the QorIQ family of SoCs.

=====================================================================
DCE Node

Description

    Node defines the base address of the DCE block.
    This block specifies the address range of all global
    configuration registers for the DCE block.  It
    also receives error interrupts


PROPERTIES

   - compatible
      Usage: required
      Value type: <string>
      Definition: Must include "fsl,dce"

   - reg
      Usage: required
      Value type: <prop-encoded-array>
      Definition: A standard property.  Specifies the physical
          address and length of the DCE configuration registers.
          registers

   - interrupts
      Usage: required
      Value type: <prop_encoded-array>
      Definition:  Specifies the interrupts generated by this
           device.  The value of the interrupts property
           consists of one interrupt specifier. The format
           of the specifier is defined by the binding document
           describing the node's interrupt parent.
           This device only generates an error interrupt.

   Note: All other standard properties (see the ePAPR) are allowed
   but are optional.


EXAMPLE
	dce@312000 {
		compatible = "fsl,dce";
		reg = <0x312000 0x10000>;
		interrupts = <16 2 1 4>;
	};

=====================================================================
```

## Documentation/devicetree/bindings/tdm/fsl-tdm.txt
```
=====================================================================
TDM Device Tree Binding
Copyright (C) 2012 Freescale Semiconductor Inc.

NOTE: The bindings described in this document are preliminary
and subject to change.

=====================================================================
TDM (Time Division Multiplexing)

DESCRIPTION

The TDM is full duplex serial port designed to allow various devices including
digital signal processors (DSPs) to communicate with a variety of serial devices
including industry standard framers, codecs, other DSPs and microprocessors.

The below properties describe the device tree bindings for Freescale TDM
controller.
This TDM controller is available on various Freescale Processors like
MPC8313, P1020, P1022 and P1010.

PROPERTIES

  - compatible
      Usage: required
      Value type: <string>
      Definition: Should contain "fsl,tdm1.0".

  - reg
      Usage: required
      Definition: A standard property. The first reg specifier describes the
          TDM registers, and the second describes the TDM DMAC registers.

  - clock-frequency
      Usage: optional
      Value type: <u32 or u64>
      Definition: The frequency at which the TDM block is operating.

  - interrupts
      Usage: required
      Definition: Definition: Two interrupt specifiers.  The first is TDM
          error, and the second is TDM EMAC.

  - phy-handle
      Usage: optional
      Value type: <phandle>
      Definition: Phandle of the line controller node or framer node eg. SLIC,
          E1/T1 etc.

  - fsl,max-time-slots
      Usage: required
      Value type: <u32>
      Definition: Maximum number of 8-bit time slots in one TDM frame.
          This is the maximum number which TDM hardware supports.

EXAMPLE

	tdm@16000 {
		compatible = "fsl,tdm1.0";
		reg = <0x16000 0x200 0x2c000 0x2000>;
		clock-frequency = <0>;
		interrupts = <16 8 62 8>;
		phy-handle = <&zarlink1>;
		fsl,max-time-slots = <128>;
	};
```

## Documentation/devicetree/bindings/tdm/pq-mds-t1.txt
```
=====================================================================
FSL PQ_MDS_T1 Device Tree Binding
Copyright (C) 2012 Freescale Semiconductor Inc.

=====================================================================
Introduction

The PQ-MDS-T1 -	A board card with the T1/E1/DS3/T3/SLIC-SLAC module
		which serves as a platform for S/W and H/W development
		around the host device, it is connected by PMC sockets.

1.TDM PHY
	Function : DS26528 T1/E1/J1 transceiver

Properties
  - compatible
	Usage: required
	Value type: <string>
	Definition: Should be "fsl,pq-mds-t1".
  - reg
	Usage: required
	Value type: <prop-encoded-array>
	Definition: The first reg specifier describes the the address,
		and the second describes the length.
  - line-rate
	Usage: required
	Value type: <string>
	Definition: It descrbets the line rate "e1" or "t1". "e1" is 2.048MHz
		"t1" is 1.544MHz.
  - fsl,trans-mode
	Usage: required
	Value type: <string>
	Definition: TDM controller transfer mode setting
		Normal operation: set fsl,trans-mode = "normal". In this mode,
			controller sends and receives data normally.
		Loopback operation: set fsl,trans-mode = "internal-loopback".
			In this mode, the data is sent via tsa tx pin and
			received from tsa rx pin.
Example

	ds26528: tdm-phy@0 {
		compatible = "dallas,ds26528";
		reg = <0 0x2000>;
		line-rate = "e1";
		fsl,trans-mode = "normal";
	};

2.PQ-MDS-T1 PLD
	Function: Board identification, control and clock/signal routing

Properties
  - fsl,card-support
	Usage: required
	Value type: <u32>
	Definition: This property use phandle to describe which it serves as,
		ds26528 or zarlink.

Example
	pld-reg@2000 {
		compatible = "fsl,pq-mds-t1-pld";
		reg = <0x2000 0x1000>;
		fsl,card-support = <&ds26528>;
	}
```

## arch/powerpc/configs/85xx/bsc913x_smp_defconfig
```kconfig
CONFIG_PPC_85xx=y
CONFIG_SMP=y
CONFIG_NR_CPUS=2
CONFIG_EXPERIMENTAL=y
# CONFIG_LOCALVERSION_AUTO is not set
CONFIG_SYSVIPC=y
CONFIG_POSIX_MQUEUE=y
CONFIG_AUDIT=y
CONFIG_NO_HZ=y
CONFIG_HIGH_RES_TIMERS=y
CONFIG_BSD_PROCESS_ACCT=y
CONFIG_IKCONFIG=y
CONFIG_IKCONFIG_PROC=y
CONFIG_LOG_BUF_SHIFT=14
CONFIG_SYSFS_DEPRECATED=y
CONFIG_SYSFS_DEPRECATED_V2=y
CONFIG_BLK_DEV_INITRD=y
CONFIG_SYSCTL_SYSCALL=y
CONFIG_EMBEDDED=y
CONFIG_SLAB=y
CONFIG_MODULES=y
CONFIG_MODULE_UNLOAD=y
CONFIG_MODULE_FORCE_UNLOAD=y
# CONFIG_BLK_DEV_BSG is not set
CONFIG_PARTITION_ADVANCED=y
CONFIG_MAC_PARTITION=y
# CONFIG_EFI_PARTITION is not set
CONFIG_BSC9131_RDB=y
CONFIG_BSC9132_QDS=y
CONFIG_PPC_QEMU_E500=y
CONFIG_HIGHMEM=y
# CONFIG_CORE_DUMP_DEFAULT_ELF_HEADERS is not set
CONFIG_MATH_EMULATION=y
CONFIG_SWIOTLB=y
CONFIG_PCI=y
CONFIG_PCIEPORTBUS=y
# CONFIG_PCIEAER is not set
# CONFIG_PCIEASPM is not set
CONFIG_PCI_MSI=y
CONFIG_ADVANCED_OPTIONS=y
CONFIG_LOWMEM_CAM_NUM_BOOL=y
CONFIG_LOWMEM_CAM_NUM=6
CONFIG_NET=y
CONFIG_PACKET=y
CONFIG_UNIX=y
CONFIG_XFRM_USER=y
CONFIG_NET_KEY=y
CONFIG_INET=y
CONFIG_IP_MULTICAST=y
CONFIG_IP_ADVANCED_ROUTER=y
CONFIG_IP_MULTIPLE_TABLES=y
CONFIG_IP_ROUTE_MULTIPATH=y
CONFIG_IP_ROUTE_VERBOSE=y
CONFIG_IP_PNP=y
CONFIG_IP_PNP_DHCP=y
CONFIG_IP_PNP_BOOTP=y
CONFIG_IP_PNP_RARP=y
CONFIG_NET_IPIP=y
CONFIG_IP_MROUTE=y
CONFIG_IP_PIMSM_V1=y
CONFIG_IP_PIMSM_V2=y
CONFIG_ARPD=y
CONFIG_INET_AH=y
CONFIG_INET_ESP=y
CONFIG_INET_IPCOMP=y
# CONFIG_INET_LRO is not set
CONFIG_IPV6=y
CONFIG_INET6_AH=y
CONFIG_NETFILTER=y
CONFIG_NF_CONNTRACK=y
CONFIG_NF_CONNTRACK_EVENTS=y
CONFIG_NF_CONNTRACK_FTP=y
CONFIG_NF_CONNTRACK_TFTP=y
CONFIG_NETFILTER_XT_MATCH_HL=y
CONFIG_NF_CONNTRACK_IPV4=y
CONFIG_IP_NF_IPTABLES=y
CONFIG_IP_NF_FILTER=y
CONFIG_IP_NF_TARGET_REJECT=y
CONFIG_IP_NF_MANGLE=y
CONFIG_BRIDGE=y
CONFIG_VLAN_8021Q=y
CONFIG_UEVENT_HELPER_PATH="/sbin/hotplug"
CONFIG_DEVTMPFS=y
CONFIG_DEVTMPFS_MOUNT=y
CONFIG_MTD=y
CONFIG_MTD_CMDLINE_PARTS=y
CONFIG_MTD_CHAR=y
CONFIG_MTD_BLOCK=y
CONFIG_FTL=y
CONFIG_MTD_CFI=y
CONFIG_MTD_CFI_INTELEXT=y
CONFIG_MTD_CFI_AMDSTD=y
CONFIG_MTD_PHYSMAP_OF=y
CONFIG_MTD_M25P80=y
CONFIG_MTD_NAND=y
CONFIG_MTD_NAND_PLATFORM=y
CONFIG_MTD_NAND_FSL_ELBC=y
CONFIG_MTD_NAND_FSL_IFC=y
CONFIG_MTD_NAND_FSL_UPM=y
CONFIG_MTD_UBI=y
CONFIG_PROC_DEVICETREE=y
CONFIG_BLK_DEV_LOOP=y
CONFIG_BLK_DEV_RAM=y
CONFIG_BLK_DEV_RAM_SIZE=131072
CONFIG_BLK_DEV_SD=y
CONFIG_CHR_DEV_ST=y
CONFIG_BLK_DEV_SR=y
CONFIG_CHR_DEV_SG=y
CONFIG_SCSI_MULTI_LUN=y
CONFIG_SCSI_LOGGING=y
CONFIG_ATA=y
CONFIG_SATA_AHCI=y
CONFIG_SATA_FSL=y
CONFIG_SATA_SIL24=y
CONFIG_MD=y
CONFIG_BLK_DEV_MD=y
# CONFIG_MD_AUTODETECT is not set
CONFIG_MD_RAID456=y
CONFIG_NETDEVICES=y
CONFIG_DUMMY=y
CONFIG_MII=y
# CONFIG_NET_VENDOR_3COM is not set
CONFIG_GIANFAR=y
CONFIG_E1000E=y
CONFIG_VITESSE_PHY=y
CONFIG_FIXED_PHY=y
CONFIG_PPP=y
CONFIG_PPPOE=y
CONFIG_PPP_ASYNC=y
CONFIG_INPUT_FF_MEMLESS=m
# CONFIG_INPUT_MOUSEDEV is not set
# CONFIG_INPUT_KEYBOARD is not set
# CONFIG_INPUT_MOUSE is not set
CONFIG_SERIO_LIBPS2=y
CONFIG_SERIAL_8250=y
CONFIG_SERIAL_8250_CONSOLE=y
CONFIG_SERIAL_8250_MANY_PORTS=y
CONFIG_SERIAL_8250_DETECT_IRQ=y
CONFIG_SERIAL_8250_RSA=y
CONFIG_NVRAM=y
CONFIG_I2C=y
CONFIG_I2C_CHARDEV=y
CONFIG_I2C_MPC=y
CONFIG_SPI=y
CONFIG_SPI_BITBANG=y
CONFIG_SPI_FSL_ESPI=y
CONFIG_GPIOLIB=y
# CONFIG_HWMON is not set
CONFIG_WATCHDOG=y
CONFIG_WATCHDOG_NOWAYOUT=y
CONFIG_BOOKE_WDT=y
CONFIG_VIDEO_OUTPUT_CONTROL=y
CONFIG_USB=y
CONFIG_USB_EHCI_HCD=y
# CONFIG_USB_EHCI_TT_NEWSCHED is not set
CONFIG_USB_EHCI_FSL=y
CONFIG_USB_STORAGE=y
CONFIG_MMC=y
CONFIG_MMC_UNSAFE_RESUME=y
CONFIG_MMC_SDHCI=y
CONFIG_MMC_SDHCI_PLTFM=y
CONFIG_MMC_SDHCI_OF_ESDHC=y
CONFIG_RTC_CLASS=y
CONFIG_RTC_DRV_DS1307=y
CONFIG_RTC_DRV_DS3232=y
CONFIG_RTC_DRV_CMOS=y
CONFIG_DMADEVICES=y
CONFIG_FSL_DMA=y
# CONFIG_NET_DMA is not set
CONFIG_ASYNC_TX_DMA=y
CONFIG_UIO=y
CONFIG_EXT2_FS=y
CONFIG_EXT3_FS=y
# CONFIG_EXT3_DEFAULTS_TO_ORDERED is not set
CONFIG_XFS_FS=y
CONFIG_ISO9660_FS=m
CONFIG_JOLIET=y
CONFIG_ZISOFS=y
CONFIG_UDF_FS=m
CONFIG_MSDOS_FS=m
CONFIG_VFAT_FS=y
CONFIG_NTFS_FS=y
CONFIG_PROC_KCORE=y
CONFIG_TMPFS=y
CONFIG_JFFS2_FS=y
CONFIG_JFFS2_FS_DEBUG=1
CONFIG_JFFS2_FS_WBUF_VERIFY=y
CONFIG_JFFS2_SUMMARY=y
CONFIG_JFFS2_FS_XATTR=y
CONFIG_JFFS2_COMPRESSION_OPTIONS=y
CONFIG_JFFS2_LZO=y
CONFIG_JFFS2_RUBIN=y
CONFIG_UBIFS_FS=y
CONFIG_NFS_FS=y
CONFIG_NFS_V4=y
CONFIG_ROOT_NFS=y
CONFIG_NFSD=y
CONFIG_CIFS=y
CONFIG_NLS_CODEPAGE_437=y
CONFIG_NLS_ISO8859_1=y
CONFIG_CRC_T10DIF=y
# CONFIG_FTRACE is not set
CONFIG_CRYPTO_NULL=y
CONFIG_CRYPTO_CTR=y
CONFIG_CRYPTO_PCBC=y
CONFIG_CRYPTO_XCBC=y
CONFIG_CRYPTO_SHA512=y
# CONFIG_CRYPTO_ANSI_CPRNG is not set
CONFIG_CRYPTO_DEV_FSL_CAAM=y
CONFIG_CRYPTO_DEV_FSL_CAAM_INTC=y
```
