## Documentation/devicetree/bindings/powerpc/fsl/cpm_qe/qe/ucc.txt
```
* UCC (Unified Communications Controllers)

Required properties:
- device_type : should be "network", "hldc", "uart", "transparent"
  "bisync", "atm", "tdm" or "serial".
- compatible : Describes the specific device attached to the UCC.
  Examples include "ucc_geth", "fsl_atm", "ucc_uart" and "fsl,ucc-tdm".
- cell-index : the ucc number(1-8), corresponding to UCCx in UM.
- reg : Offset and length of the register set for the device
- interrupts : <a b> where a is the interrupt number and b is a
  field that represents an encoding of the sense and level
  information for the interrupt.  This should be encoded based on
  the information in section 2) depending on the type of interrupt
  controller you have.
- interrupt-parent : the phandle for the interrupt controller that
  services interrupts for this device.
- pio-handle : The phandle for the Parallel I/O port configuration.
- port-number : for UART drivers, the port number to use, between 0 and 3.
  This usually corresponds to the /dev/ttyQE device, e.g. <0> = /dev/ttyQE0.
  The port number is added to the minor number of the device.  Unlike the
  CPM UART driver, the port-number is required for the QE UART driver.
- soft-uart : for UART drivers, if specified this means the QE UART device
  driver should use "Soft-UART" mode, which is needed on some SOCs that have
  broken UART hardware.  Soft-UART is provided via a microcode upload.
- rx-clock-name: the UCC receive clock source
  "none": clock source is disabled
  "brg1" through "brg16": clock source is BRG1-BRG16, respectively
  "clk1" through "clk24": clock source is CLK1-CLK24, respectively
- tx-clock-name: the UCC transmit clock source
  "none": clock source is disabled
  "brg1" through "brg16": clock source is BRG1-BRG16, respectively
  "clk1" through "clk24": clock source is CLK1-CLK24, respectively
The following two properties are deprecated.  rx-clock has been replaced
with rx-clock-name, and tx-clock has been replaced with tx-clock-name.
Drivers that currently use the deprecated properties should continue to
do so, in order to support older device trees, but they should be updated
to check for the new properties first.
- rx-clock : represents the UCC receive clock source.
  0x00 : clock source is disabled;
  0x1~0x10 : clock source is BRG1~BRG16 respectively;
  0x11~0x28: clock source is QE_CLK1~QE_CLK24 respectively.
- tx-clock: represents the UCC transmit clock source;
  0x00 : clock source is disabled;
  0x1~0x10 : clock source is BRG1~BRG16 respectively;
  0x11~0x28: clock source is QE_CLK1~QE_CLK24 respectively.

Required properties for network device_type:
- mac-address : list of bytes representing the ethernet address.
- phy-handle : The phandle for the PHY connected to this controller.

Recommended properties:
- phy-connection-type : a string naming the controller/PHY interface type,
  i.e., "mii" (default), "rmii", "gmii", "rgmii", "rgmii-id" (Internal
  Delay), "rgmii-txid" (delay on TX only), "rgmii-rxid" (delay on RX only),
  "tbi", or "rtbi".

Required properties for fsl, ucc-tdm, compatible:
- fsl,rx-sync-clock, fsl,tx-sync-clock: the TDM sync clock source for
  receive/transmit
  "none": clock source is disabled
  "rsync_pin" : clock source is TDM_A1 RSYNC pin
  "brg9" through "brg15" : clock source is BRG9-BRG15, respectively
- fsl,tdm-tx-timeslot, fsl,tdm-rx-timeslot: time slot mask for transmit/receive
  Each bit (LSB first) corresponds to a time slot. The time slot is enabled
  if the bit is set
- fsl,tdm-id : It is the tdm port number. e.g. P1021E has 4 ports -  port
	A/B/C/D mapping to number 0/1/2/3.
- fsl,tdm-framer-type : It should be "t1" or "e1", "t1" for T1 line rate, and
	"e1" for E1 line rate
- fsl,tdm-mode : It is tsa working mode. It should be "normal" or
	"internal-loopback"
- fsl,siram-entry-id : This number is used for setting index siram entry
	It should be 0/2/4.../14. Each TDM should not use the same number
	with others
Example:
	ucc@2000 {
		device_type = "network";
		compatible = "ucc_geth";
		cell-index = <1>;
		reg = <2000 200>;
		interrupts = <a0 0>;
		interrupt-parent = <700>;
		mac-address = [ 00 04 9f 00 23 23 ];
		rx-clock = "none";
		tx-clock = "clk9";
		phy-handle = <212000>;
		phy-connection-type = "gmii";
		pio-handle = <140001>;
	};

	tdmc: ucc@2400 {
		compatible = "fsl,ucc-tdm";
		cell-index = <5>;
		reg = <0x2400 0x200>;
		interrupts = <40>;
		interrupt-parent = <&qeic>;
		rx-clock-name = "clk7";
		tx-clock-name = "clk13";
		fsl,rx-sync-clock = "rsync_pin";
		fsl,tx-sync-clock = "tsync_pin";
		fsl,tx-timeslot = <0x00ffffff>;
		fsl,rx-timeslot = <0x00ffffff>;
		pio-handle = <&pio_tdmc>;
		fsl,tdm-framer-type = "t1";
		fsl,tdm-mode = "normal";
		fsl,tdm-id = <2>;
		fsl,siram-entry-id = <4>;
		phy-handle = <&tdmphy>;
	};
```

## Documentation/devicetree/bindings/powerpc/fsl/fman_chosen_node_device_tree.txt
```
=================================================================================
Chosen Node - DPAA extended arguments Bindings

Copyright 2013 Freescale Semiconductor Inc.

CONTENTS
  - FMan Extended Args Node
  - FMan-Port Extended Args Node
  - Example

NOTE: The bindings described in this document are preliminary and subject to change.

=================================================================================
FMan Extended Args Node

DESCRIPTION

The purpose of this node it to provide means to implicitly initialize some of the
FMan advanced arguments as described below. This node is entirely optional; i.e.
the FMan Linux driver already sets the appropriate default values that should
fit most of the standard applications.

PROPERTIES

  - compatible
      Usage: required
      Value type: <string>
      Definition: Must include "fsl,fman-extended-args"

  - cell-index
      Usage: required
      Value type: <u32>
      Definition: Specifies the index of the FMan unit. The index should match
        exactly the numbering of the cell-index of the FMan device-tree node.
        It is recommended to use the "reference-to-node" method to assure matching.

  - dma-aid-mode
      Usage: optional
      Value type: <string>
      Definition: Sets the AID mode.
        The optional values are "port" and "tnum".

Example

fman1-extd-args {
    cell-index = <1>;
    compatible = "fsl,fman-extended-args";
    dma-aid-mode = "port";
};

=================================================================================
FMan-Port Extended Args Node

DESCRIPTION

The purpose of this node it to provide means to implicitly initialize some of the
FMan-port advanced arguments as described below. This node supports all FMan-Port
types: OP, RX, 10G-RX, TX and 10G-TX ports. This node is entirely optional; i.e.
the FMan Linux driver already sets the appropriate default values that should
fit most of the standard applications.

PROPERTIES

  - compatible
      Usage: required
      Value type: <string>
      Definition: A standard property.
          An Offline-Parsing port must include "fsl,fman-port-op-extended-args".
          The Rx port must include "fsl,fman-port-1g-rx-extended-args" or
          "fsl,fman-port-10g-rx-extended-args" for 10G Rx ports.
          The Tx port must include "fsl,fman-port-1g-tx-extended-args" or
          "fsl,fman-port-10g-tx-extended-args" for 10G Tx ports.

  - cell-index
      Usage: required
      Value type: <u32>
      Definition: Specifies the index of the FMan Port unit.
          The types of ports: offline-parsing, 1G Rx, 10G Rx, 1G Tx and 10G Tx
          ports. The index should match exactly the numbering of the cell-index of the
          FMan-Port device-tree node. It is recommended to use the "reference-to-node"
          method to assure matching.

  - num-tnums
      Usage: optional
      Value type: <prop-encoded-array>
      Definition: Specifies the number of tnums required (first value)
        as well as the extra required tnums (second value).
        In the fman-port case "tnums" represent the number of tasks that the
        Fman controller allocates to handle the appropriate port RX or TX activities.
        For more details please refer to the Fman RM.

  - num-dmas
      Usage: optional
      Value type: <prop-encoded-array>
      Definition: Specifies the number of dmas required (first value)
        as well as the extra required dmas (second value).
        In the fman-port case "num-dmas" represent the number of dma channels
        that the Fman controller allocates to handle the appropriate port
        RX or TX activities.
        For more details please refer to the Fman RM.

  - fifo-size
      Usage: optional
      Value type: <prop-encoded-array>
      Definition: Specifies the fifo size required (first value)
        as well as the extra size required (second value).
        In the fman-port case "fifo-size" represent the size of memory (in bytes)
        that the Fman controller allocates to handle the appropriate port
        RX or TX activities.
        For more details please refer to the Fman RM.

  - buffer-layout
      Usage: optional
      Value type: <prop-encoded-array>
      Definition: Specifies the manipulation extra space needed (first value)
        and the data alignment (second value).
        For more information please refer to the FMan User's guide

  - vsp-window
      Usage: optional
      Value type: <prop-encoded-array>
      Definition: Specifies the number of profiles for this port (first value)
        and the dfault virtual port eelative id (second value).
        For more information please refer to the FMan User's guide

  - errors-to-discard
      Usage: optional
      Value type: <u32>
      Definition: Specifies which errors should be discarded.
        Errors that are not in the mask, will not be discarded;
        I.e. those errors will be enqueued and sent to the default error queue.        

Example

fman1_rx4-extd-args {
    cell-index = <4>;
    compatible = "fsl,fman-port-1g-rx-extended-args";
    num-tnums = <16 0>;
    num-dmas = <8 0>;
    fifo-size = <0x3000 0>;
    buffer-layout = <64 128>;
    vsp-window = <8 0>;
    errors-to-discard = <0x00020000>;
};

=================================================================================
Example

chosen {
    name = "chosen";

    dpaa-extended-args {
        fman1-extd-args {
            cell-index = <1>;
            compatible = "fsl,fman-extended-args";
            dma-aid-mode = "port";

            fman1_rx4-extd-args {
                cell-index = <4>;
                compatible = "fsl,fman-port-1g-rx-extended-args";
                policer-profile-window = <8>;
                num-tnums = <16 0>;
                num-dmas = <8 0>;
                fifo-size = <0x3000 0>;
                buffer-layout = <64 128>;
                vsp-window = <8 0>;
                errors-to-discard = <0x00020000>;                
            };

            fman1_tx4-extd-args {
                cell-index = <4>;
                compatible = "fsl,fman-port-1g-tx-extended-args";
                num-tnums = <16 0>;
                num-dmas = <8 0>;
                fifo-size = <0x3000 0>;
            };
        };
    };
};
```
