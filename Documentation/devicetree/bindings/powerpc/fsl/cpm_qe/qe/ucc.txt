## drivers/net/ethernet/freescale/dpa/Kconfig
```kconfig
menuconfig FSL_DPAA_ETH
	bool "DPAA Ethernet"
	depends on FSL_SOC && FSL_BMAN && FSL_QMAN && FSL_FMAN
	select PHYLIB
	select FSL_DPAA_TX_RECYCLE if FMAN_T4240
	---help---
	  Data Path Acceleration Architecture Ethernet driver, supporting the
	  Freescale QorIQ chips.

if FSL_DPAA_ETH

config FSL_DPAA_OFFLINE_PORTS
	bool "Offline Ports support"
	depends on FSL_DPAA_ETH
	default y
	---help---
	  The Offline Parsing / Host Command ports (short: OH ports, of Offline ports) provide
	  most of the functionality of the regular, online ports, except they receive their
	  frames from a core or an accelerator on the SoC, via QMan frame queues,
	  rather than directly from the network.
	  Offline ports are configured via PCD (Parse-Classify-Distribute) schemes, just like
	  any online FMan port. They deliver the processed frames to frame queues, according
	  to the applied PCD configurations.

	  Choosing this feature will not impact the functionality and/or performance of the system,
	  so it is safe to have it.

config FSL_DPAA_ETH_JUMBO_FRAME
	bool "Optimize for jumbo frames (EXPERIMENTAL)"
	depends on EXPERIMENTAL
	select FMAN_RESOURCE_ALLOCATION_ALGORITHM if (FMAN_P3040_P4080_P5020 || FMAN_P1023)
	default n
	---help---
	  Optimize the DPAA Ethernet driver throughput for large frames
	  termination traffic (e.g. 4K and above).
	  NOTE: This option can only be used if FSL_FM_MAX_FRAME_SIZE
	  is set to 9600 bytes.
	  Using this option in combination with small frames increases
	  significantly the driver's memory footprint and may even deplete
	  the system memory.

config FSL_DPAA_TX_RECYCLE
	bool
	depends on FSL_DPAA_ETH
	depends on FMAN_T4240

config FSL_DPAA_1588
	tristate "IEEE 1588-compliant timestamping"
	depends on FSL_DPAA_ETH
	default n
	---help---
	 Enable IEEE1588 support code.

config FSL_DPAA_TS
	tristate "Linux compliant timestamping"
	depends on FSL_DPAA_ETH
	default n
	---help---
	  Enable Linux API compliant timestamping support.

choice FSL_DPAA_ETH_WQ_ASSIGN
	prompt "WorkQueue assignment scheme for FrameQueues"
	depends on FSL_DPAA_ETH
	default FSL_DPAA_ETH_WQ_MULTI
	---help---
	  Selects the FrameQueue to WorkQueue assignment scheme.

	config FSL_DPAA_ETH_WQ_LEGACY
		bool "Legacy WQ assignment"
		---help---
		  Statically-defined FQIDs are round-robin assigned to all WQs (0..7). PCD queues are always
		  in this category. Other frame queues may be those used for "MAC-less" or "shared MAC" configurations
		  of the driver.
		  Dynamically-defined FQIDs all go to WQ7.
	config FSL_DPAA_ETH_WQ_MULTI
	bool "Multi-WQ assignment"
	---help---
	  Tx Confirmation FQs go to WQ1.
	  Rx Default, Tx and PCD FQs go to WQ3.
	  Rx Error and Tx Error FQs go to WQ2.
endchoice

config FSL_DPAA_ETH_USE_NDO_SELECT_QUEUE
	bool "Use driver's Tx queue selection mechanism"
	default y
	depends on FSL_DPAA_ETH
	---help---
	  The DPAA-Ethernet driver defines a ndo_select_queue() callback for optimal selection
	  of the egress FQ. That will override the XPS support for this netdevice.
	  If for whatever reason you want to be in control of the egress FQ-to-CPU selection and mapping,
	  or simply don't want to use the driver's ndo_select_queue() callback, then unselect this
	  and use the standard XPS support instead.

config FSL_DPAA_ETH_MAX_BUF_COUNT
	int "Maximum nuber of buffers in private bpool"
	depends on FSL_DPAA_ETH
	range 64 2048
	default "128"
	---help---
	  The maximum number of buffers to be by default allocated in the DPAA-Ethernet private port's
	  buffer pool. One needn't normally modify this, as it has probably been tuned for performance
	  already. This cannot be lower than DPAA_ETH_REFILL_THRESHOLD.

config FSL_DPAA_ETH_REFILL_THRESHOLD
	int "Private bpool refill threshold"
	depends on FSL_DPAA_ETH
	range 32 FSL_DPAA_ETH_MAX_BUF_COUNT
	default "80"
	---help---
	  The DPAA-Ethernet driver will start replenishing buffer pools whose count
	  falls below this threshold. This must be related to DPAA_ETH_MAX_BUF_COUNT. One needn't normally
	  modify this value unless one has very specific performance reasons.

config FSL_DPAA_CS_THRESHOLD_1G
	hex "Egress congestion threshold on 1G ports"
	depends on FSL_DPAA_ETH
	range 0x1000 0x10000000
	default "0x06000000"
	---help---
	  The size in bytes of the egress Congestion State notification threshold on 1G ports.
	  The 1G dTSECs can quite easily be flooded by cores doing Tx in a tight loop
	  (e.g. by sending UDP datagrams at "while(1) speed"),
	  and the larger the frame size, the more acute the problem.
	  So we have to find a balance between these factors:
	       - avoiding the device staying congested for a prolonged time (risking
                 the netdev watchdog to fire - see also the tx_timeout module param);
               - affecting performance of protocols such as TCP, which otherwise
	         behave well under the congestion notification mechanism;
	       - preventing the Tx cores from tightly-looping (as if the congestion
	         threshold was too low to be effective);
	       - running out of memory if the CS threshold is set too high.

config FSL_DPAA_CS_THRESHOLD_10G
	hex "Egress congestion threshold on 10G ports"
	depends on FSL_DPAA_ETH
	range 0x1000 0x20000000
	default "0x10000000"
	---help ---
	  The size in bytes of the egress Congestion State notification threshold on 10G ports.

config FSL_DPAA_INGRESS_CS_THRESHOLD
	hex "Ingress congestion threshold on FMan ports"
	depends on FSL_DPAA_ETH
	default "0x10000000"
	---help---
	  The size in bytes of the ingress tail-drop threshold on FMan ports.
	  Traffic piling up above this value will be rejected by QMan and discarded by FMan.

config FSL_DPAA_ETH_DEBUGFS
	tristate "DPAA Ethernet debugfs interface"
	depends on DEBUG_FS && FSL_DPAA_ETH
	default y
	---help---
	  This option compiles debugfs code for the DPAA Ethernet driver.

config FSL_DPAA_ETH_DEBUG
	bool "DPAA Ethernet Debug Support"
	depends on FSL_DPAA_ETH
	default n
	---help---
	  This option compiles debug code for the DPAA Ethernet driver.

endif # FSL_DPAA_ETH
```

## drivers/net/ethernet/freescale/fman/Kconfig
```kconfig
menu "Frame Manager support"

menuconfig FSL_FMAN
	bool "Freescale Frame Manager (datapath) support"
	depends on FSL_SOC && FSL_BMAN && FSL_QMAN
	default y
	---help---
		If unsure, say Y.

if FSL_FMAN

config FSL_FMAN_TEST
	bool "FMan test module"
	default n
	---help---
		This option compiles test code for FMan.

menu "FMAN Processor support"
choice
	depends on FSL_FMAN
	prompt "Processor Type"

config FMAN_P3040_P4080_P5020
	bool "P3040 P4080 5020"

config FMAN_P1023
	bool "P1023"

config FMAN_T4240
	bool "T4240"

endchoice
endmenu

config FMAN_RESOURCE_ALLOCATION_ALGORITHM
	bool "Enable FMan dynamic resource allocation algorithm"
	default y if ((FMAN_P3040_P4080_P5020 || FMAN_P1023) && FSL_DPAA_ETH_OPTIMIZE_FOR_IPFWD)
	---help---
		Enables algorithm for dynamic resource allocation

config FMAN_DISABLE_OH_TO_REUSE_RESOURCES
	depends on FMAN_RESOURCE_ALLOCATION_ALGORITHM
	bool "Disable offline parsing ports to reuse resources"
	default n
	---help---
		Redistributes FMan OH's resources to all other ports,
		thus enabling other configurations.

config FMAN_MIB_CNT_OVF_IRQ_EN
	bool "Enable the dTSEC MIB counters overflow interrupt"
	default n
	---help---
		Enable the dTSEC MIB counters overflow interrupt to get
		accurate MIB counters values. Enabled it compensates
		for the counters overflow but reduces performance and
		triggers error messages in HV setups.

config FSL_FM_MAX_FRAME_SIZE
	int "Maximum L2 frame size"
	depends on FSL_FMAN
	range 64 9600
	default "1522"
	help
		Configure this in relation to the maximum possible MTU of your
		network configuration. In particular, one would need to
		increase this value in order to use jumbo frames.
		FSL_FM_MAX_FRAME_SIZE must accomodate the Ethernet FCS (4 bytes)
		and one ETH+VLAN header (18 bytes), to a total of 22 bytes in
		excess of the desired L3 MTU.

		Note that having too large a FSL_FM_MAX_FRAME_SIZE (much larger
		than the actual MTU) may lead to buffer exhaustion, especially
		in the case of badly fragmented datagrams on the Rx path.
		Conversely, having a FSL_FM_MAX_FRAME_SIZE smaller than the actual
		MTU will lead to frames being dropped.

		This can be overridden by specifying "fsl_fm_max_frm" in
		the kernel bootargs:
		 * in Hypervisor-based scenarios, by adding a "chosen" node
		with the "bootargs" property specifying
		"fsl_fm_max_frm=<YourValue>";
		 * in non-Hypervisor-based scenarios, via u-boot's env, by
		modifying the "bootargs" env variable.

config FSL_FM_RX_EXTRA_HEADROOM
	int "Add extra headroom at beginning of data buffers"
	depends on FSL_FMAN
	range 0 384
	default "64"
	help
		Configure this to tell the Frame Manager to reserve some extra
		space at the beginning of a data buffer on the receive path,
		before Internal Context fields are copied. This is in addition
		to the private data area already reserved for driver internal
		use. The option does not affect in any way the layout of
		transmitted buffers. You may be required to enable the config
		option FMAN_RESOURCE_ALLOCATION_ALGORITHM and also
		FMAN_DISABLE_OH_TO_REUSE_RESOURCES to have enough resources
		when using this option and also supporting jumbo frames.

		This setting can be overridden by specifying
		"fsl_fm_rx_extra_headroom" in the kernel bootargs:
		 * in Hypervisor-based scenarios, by adding a "chosen" node
		with the "bootargs" property specifying
		"fsl_fm_rx_extra_headroom=<YourValue>";
		 * in non-Hypervisor-based scenarios, via u-boot's env, by
		modifying the "bootargs" env variable.

endif # FSL_FMAN

endmenu
```

## drivers/staging/fsl_dpa_offload/Kconfig
```kconfig
config FSL_DPA_OFFLOAD
	tristate "Freescale Datapath Offloading Driver"
	depends on FSL_FMAN
	select CRC8
	default n
	---help---
		The driver supports DPAA offloading capabilities.
		    * Classifier component makes possible the offloading of
		      classification rules by configuring the FMAN hardware.
		    * DPA IPsec component makes possible the offloading of
		      security operations (ESP) by configuring the onboard
		      SEC 4.x.

		To compile this driver as a module, choose M here. The module
		will be called dpa_offload.
```

## drivers/tdm/Kconfig
```kconfig
#
# TDM subsystem configuration
#

menuconfig TDM
	tristate "TDM support"
	---help---
	  More information is contained in the directory <file:Documentation/tdm/>,
	  especially in the file called "summary" there.
	  If you want TDM support, you should say Y here and also to the
	  specific driver for your bus adapter(s) below.

	  This TDM support can also be built as a module.  If so, the module
	  will be called tdm-core.

if TDM

config TDM_DEBUG_CORE
	bool "TDM Core debugging messages"
	help
	  Say Y here if you want the TDM core to produce a bunch of debug
	  messages to the system log.  Select this if you are having a
	  problem with TDM support and want to see more of what is going on.

source drivers/tdm/test/Kconfig
source drivers/tdm/device/Kconfig
source drivers/tdm/line_ctrl/Kconfig
endif # TDM
```

## drivers/tdm/device/Kconfig
```kconfig
#
# TDM device configuration
#

menu "TDM Device support"

config TDM_FSL
        tristate "Driver for Freescale TDM controller"
        depends on FSL_SOC
        ---help---
          This is a driver for Freescale TDM controller. The controller
          is found in various Freescale SOCs viz MPC8315, P1020. The TDM driver
          basically multiplexes and demultiplexes data from different channels.
          The TDM can interface SLIC kind of devices.

config FSL_UCC_TDM
       tristate "UCC TDM driver for Freescale QE engine"
       depends on FSL_SOC || CONFIG_QE
       ---help---
         This is a driver for Freescale QE UCC working with TDM interface.

endmenu
```

## drivers/tdm/line_ctrl/Kconfig
```kconfig
#
# TDM line control driver config file
#

menu "Line Control Devices"

config SLIC_ZARLINK
	tristate "Zarlink Slic intialization Module"
		default n
		---help---
		  This module initialize and configure the zarlink slic
config FSL_PQ_MDS_T1
	tristate "FSL PQ MDS T1 CARD SUPPORT"
		default n
		---help---
		  This module initializes and configures the pq-mds-t1 card
		  in T1 or E1 mode.
endmenu
```

## drivers/tdm/test/Kconfig
```kconfig
#
# TDM TEST MODULE
#

menu "TDM test"

config TDM_TEST
        tristate "TDM test Module"
	depends on FSL_SOC
	---help---
	  This TDM test module is a small test module which
	  registers with the TDM core(framework) and sets up
	  a TDM Voice path between diff channels of a slic.

config UCC_TDM_TEST
	tristate "UCC TDM test Module"
	depends on FSL_SOC || CONFIG_QE
	---help---
	  This UCC TDM test module is a small test module to test
	  ucc tdm transfer and receive data via ucc1.

endmenu
```

## drivers/vfio/Kconfig
```kconfig
config VFIO_IOMMU_TYPE1
	tristate
	depends on VFIO
	default n

config VFIO_IOMMU_FSL_PAMU
	tristate
	depends on VFIO
	default n

config VFIO_IOMMU_DUMMY
	tristate
	depends on VFIO
	default n

menuconfig VFIO
	tristate "VFIO Non-Privileged userspace driver framework"
	depends on IOMMU_API
	select VFIO_IOMMU_TYPE1 if X86
	select VFIO_IOMMU_FSL_PAMU if FSL_PAMU
	select VFIO_IOMMU_DUMMY if DUMMY_IOMMU
	help
	  VFIO provides a framework for secure userspace device drivers.
	  See Documentation/vfio.txt for more details.

	  If you don't know what to do here, say N.

source "drivers/vfio/pci/Kconfig"
source "drivers/vfio/fsl_pci_ep/Kconfig"
```

## drivers/vfio/fsl_pci_ep/Kconfig
```kconfig
config VFIO_FSL_PCI_EP
	tristate "VFIO support for Freescale PCI Endpoint devices"
	depends on VFIO && EVENTFD
	help
	  Support for the Freescale PCI EP driver. This is required to make
	  use of PCI EP drivers using the VFIO framework.

	  If you don't know what to do here, say N.
```
